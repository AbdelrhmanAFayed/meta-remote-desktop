## conf/layer.conf
```bitbake
# We have a conf and classes directory, add to BBPATH
BBPATH .= ":${LAYERDIR}"

# We have recipes-* directories, add to BBFILES
BBFILES += "${LAYERDIR}/recipes-*/*/*.bb \
            ${LAYERDIR}/recipes-*/*/*.bbappend"

BBFILE_COLLECTIONS += "meta-remote-desktop"
BBFILE_PATTERN_meta-remote-desktop = "^${LAYERDIR}/"
BBFILE_PRIORITY_meta-remote-desktop = "6"

LAYERDEPENDS_meta-remote-desktop = "core"
LAYERSERIES_COMPAT_meta-remote-desktop = "kirkstone"
```
